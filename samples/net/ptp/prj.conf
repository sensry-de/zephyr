## prj.conf
```kconfig
CONFIG_NETWORKING=y
CONFIG_NET_LOG=y
CONFIG_LOG=y
CONFIG_NET_IPV4=y
CONFIG_NET_IPV6=n
CONFIG_NET_DHCPV4=n
CONFIG_NET_UDP=y

CONFIG_TEST_RANDOM_GENERATOR=y

CONFIG_NET_PKT_RX_COUNT=32
CONFIG_NET_PKT_TX_COUNT=32
CONFIG_NET_BUF_RX_COUNT=32
CONFIG_NET_BUF_TX_COUNT=32
CONFIG_NET_MAX_CONTEXTS=10

CONFIG_INIT_STACKS=y
CONFIG_PRINTK=y
CONFIG_NET_SHELL=y
CONFIG_LOG_MODE_DEFERRED=y

# Ethernet is needed for PTP
CONFIG_ETH_DRIVER=y

CONFIG_NET_CONFIG_NEED_IPV4=y
CONFIG_NET_CONFIG_SETTINGS=y

# First ethernet interface will use these settings
CONFIG_NET_CONFIG_MY_IPV4_ADDR="10.253.101.70"
CONFIG_NET_CONFIG_PEER_IPV4_ADDR="10.253.101.1"

# PTP settings
CONFIG_PTP_CLOCK=y
CONFIG_PTP=y
CONFIG_PTP_ANNOUNCE_RECV_TIMEOUT=5
CONFIG_PTP_LOG_LEVEL_DBG=y
CONFIG_PTP_DSCP_HIGH_PRIORITY=y
CONFIG_PTP_NETWORK_MODE_HYBRID=n
CONFIG_PTP_TIME_RECEIVER_ONLY=y

# PTP sample settings
CONFIG_NET_SHELL_PTP_SUPPORTED=y
CONFIG_PTP_CLOCK_SHELL=y
CONFIG_NET_SAMPLE_RUN_DURATION=0

#CONFIG_PRECISION_TIMING_PI_KP=100
#CONFIG_PRECISION_TIMING_PI_KI=30
#CONFIG_PRECISION_TIMING_PI_OUTPUT_LIMIT_PPM=100
#CONFIG_PRECISION_TIMING_PI_INTEGRAL_LIMIT_PPM=100
```

## src/main.c
```c
/*
 * Copyright (c) 2024 BayLibre SAS
 * Copyright (c) 2026 Philipp Steiner
 *
 * SPDX-License-Identifier: Apache-2.0
 */

#include <zephyr/logging/log.h>
LOG_MODULE_REGISTER(net_ptp_sample, LOG_LEVEL_DBG);

#include <zephyr/kernel.h>
#include <zephyr/drivers/ptp_clock.h>
#include <zephyr/net/ethernet.h>

#include <errno.h>
#include <stdlib.h>

#include "ptp/clock.h"
#include "ptp/port.h"

static int run_duration = CONFIG_NET_SAMPLE_RUN_DURATION;
static struct k_work_delayable stop_sample;
static struct k_work_delayable ptp_time_work;
static struct k_sem quit_lock;

static void print_ptp_time(struct k_work *work)
{
	sys_slist_t *ports_list = ptp_clock_ports_list();

	ARG_UNUSED(work);

	if (ports_list != NULL && sys_slist_len(ports_list) > 0U) {
		struct ptp_port *port =
			CONTAINER_OF(sys_slist_peek_head(ports_list), struct ptp_port, node);
		const struct device *ptp_clock = net_eth_get_ptp_clock(port->iface);

		if (ptp_clock != NULL) {
			struct net_ptp_time time;
			int ret = ptp_clock_get(ptp_clock, &time);

			if (ret == 0) {
				LOG_INF("PTP HW time: %llu.%09u",
					(unsigned long long)time.second, time.nanosecond);
			} else {
				LOG_ERR("Failed to read PTP HW time: %d", ret);
			}
		}
	}

	k_work_reschedule(&ptp_time_work, K_SECONDS(10));
}

static void stop_handler(struct k_work *work)
{
	ARG_UNUSED(work);

	k_sem_give(&quit_lock);
}

static int get_current_status(void)
{
	struct ptp_port *port;
	sys_slist_t *ports_list = ptp_clock_ports_list();

	if (!ports_list || sys_slist_len(ports_list) == 0) {
		return -EINVAL;
	}

	port = CONTAINER_OF(sys_slist_peek_head(ports_list), struct ptp_port, node);

	if (!port) {
		return -EINVAL;
	}

	switch (ptp_port_state(port)) {
	case PTP_PS_INITIALIZING:
	case PTP_PS_FAULTY:
	case PTP_PS_DISABLED:
	case PTP_PS_LISTENING:
	case PTP_PS_PRE_TIME_TRANSMITTER:
	case PTP_PS_PASSIVE:
	case PTP_PS_UNCALIBRATED:
		LOG_INF("FAIL");
		return 0;
	case PTP_PS_TIME_RECEIVER:
		LOG_INF("TIME RECEIVER");
		return 2;
	case PTP_PS_TIME_TRANSMITTER:
	case PTP_PS_GRAND_MASTER:
		LOG_INF("TIME TRANSMITTER");
		return 1;
	}

	return -1;
}

void init_testing(void)
{
	uint32_t uptime = k_uptime_get_32();
	int ret;

	if (run_duration == 0) {
		LOG_INF("Runs forever");
		return;
	}

	LOG_INF("Stopping after %u seconds", run_duration);

	k_sem_init(&quit_lock, 0, K_SEM_MAX_LIMIT);

	k_work_init_delayable(&stop_sample, stop_handler);
	k_work_reschedule(&stop_sample, K_SECONDS(run_duration));

	k_sem_take(&quit_lock, K_FOREVER);

	LOG_INF("Stopped after %u seconds", (k_uptime_get_32() - uptime) / 1000);

	/* Try to figure out what is the sync state.
	 * Return:
	 *  <0 - configuration error
	 *   0 - not time sync
	 *   1 - we are TimeTransmitter
	 *   2 - we are TimeReceiver
	 */
	ret = get_current_status();

	/* sleep gives deferred logs time to flush */
	k_msleep(2000);
	exit(ret);
}

int main(void)
{
	k_work_init_delayable(&ptp_time_work, print_ptp_time);
	k_work_schedule(&ptp_time_work, K_NO_WAIT);

	init_testing();
	return 0;
}
```
