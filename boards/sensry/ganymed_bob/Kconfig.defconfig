## boards/sensry/ganymed_bob/ganymed_bob_sy120_gen1_defconfig
```kconfig
# Copyright (c) 2024 sensry.io
# SPDX-License-Identifier: Apache-2.0

CONFIG_SERIAL=y
CONFIG_CONSOLE=y
CONFIG_UART_CONSOLE=y

# printk defaults to log, we want default console
CONFIG_LOG_PRINTK=n
```

## drivers/adc/Kconfig.ads122c
```kconfig
# Copyright (c) 2024 sensry.io
# SPDX-License-Identifier: Apache-2.0

config ADC_ADS122C
	bool "Texas Instruments ADS122C ADC driver"
	depends on DT_HAS_TI_ADS122C_ENABLED
	default y
	select I2C
	help
	  Enable the driver implementation for the I2C based quad channel ADS122C
	  with 2 integrated IDACs.
```

## drivers/adc/Kconfig.ads122c04
```kconfig
# Copyright (c) 2026 sensry.io
# SPDX-License-Identifier: Apache-2.0

config ADC_ADS122C04
	bool "Texas Instruments ADS122C04 ADC driver"
	depends on DT_HAS_TI_ADS122C04_ENABLED
	default y
	select I2C
	select ADC_CONFIGURABLE_INPUTS
	select ADC_CONFIGURABLE_EXCITATION_CURRENT_SOURCE_PIN
	help
	  Enable the driver implementation for the I2C based quad channel ADS122C04
	  with 2 integrated IDACs.

config ADC_ADS122C04_ACQUISITION_THREAD_STACK_SIZE
	int "Stack size for the ADC data acquisition thread"
	depends on ADC_ADS122C04
	default 1024
	help
	  Size of the stack used for the internal data acquisition
	  thread.

config ADC_ADS122C04_ACQUISITION_THREAD_PRIO
	int "Priority for the ADC data acquisition thread"
	depends on ADC_ADS122C04
	default 3
	help
	  Priority level for the internal ADC data acquisition thread.
```

## drivers/ethernet/Kconfig.sy1xx_mac
```kconfig
# SPDX-License-Identifier: Apache-2.0
# Copyright (c) 2024 sensry.io

menuconfig ETH_SY1XX
	bool "Sensry SY1XX Ethernet driver"
	default y
	# depends on NET_BUF_FIXED_DATA_SIZE
	# depends on DT_HAS_SENSRY_SY1XX_MAC_ENABLED
	# select NOCACHE_MEMORY if ARCH_HAS_NOCACHE_MEMORY_SUPPORT
	select MDIO
	select PINCTRL
	help
	  Enable Atmel SAM MCU Family Ethernet driver.
```

## drivers/gpio/Kconfig.sy1xx
```kconfig
# SPDX-License-Identifier: Apache-2.0
# Copyright (c) 2024 sensry.io


config GPIO_SY1XX
	bool "SY1XX GPIO driver"
	default y
	depends on DT_HAS_SENSRY_SY1XX_GPIO_ENABLED
	help
	  Enable the SY1XX GPIO driver.
```

## drivers/mdio/Kconfig.sy1xx
```kconfig
# SPDX-License-Identifier: Apache-2.0
# Copyright (c) 2024 sensry.io

config MDIO_SENSRY_SY1XX
	bool "Sensry SY1XX MDIO driver"
	depends on ETH_SY1XX
    select PINCTRL
	default y
	help
	  Enable Sensry SY1xx SOC Family MDIO driver.
```

## dts/bindings/adc/ti,ads122c04.yaml
```yaml
# Copyright (c) 2026 The Zephyr Project Contributors
# SPDX-License-Identifier: Apache-2.0

description: Texas Instrument 24-Bit, 4-Channel, 2-kSPS, Delta-Sigma ADC, Dual-Matched Programmable Current Sources

compatible: "ti,ads122c04"

include: [adc-controller.yaml, i2c-device.yaml]

properties:
  reset-gpios:
    type: phandle-array
    description: "GPIO for reset"

  drdy-gpios:
    type: phandle-array
    description: |
      GPIO for data ready, becomes active when a conversion result is ready

  idac-current:
    type: int
    enum:
      - 0
      - 10
      - 50
      - 100
      - 250
      - 500
      - 1000
      - 1500
    default: 0
    description: |
      IDAC current in microampere, the default value turns the current source off
```

## dts/bindings/gpio/sensry,sy1xx-gpio.yaml
```yaml
description: Sensry SY1XX GPIO PORT node

compatible: "sensry,sy1xx-gpio"

include: [gpio-controller.yaml, base.yaml]

properties:
  reg:
    required: true

  "#gpio-cells":
    const: 2

gpio-cells:
  - pin
  - flags
```

## dts/bindings/mdio/sensry,sy1xx-mdio.yaml
```yaml
# Copyright (c) 2024 sensry.io
# SPDX-License-Identifier: Apache-2.0

description: Sensry SY1XX MDIO Driver node

compatible: "sensry,sy1xx-mdio"

include: [mdio-controller.yaml, pinctrl-device.yaml]

properties:
  pinctrl-0:
    required: true

  pinctrl-names:
    required: true

  timeout-msec:
    type: int
    default: 100
    description: |
      Timeout in milliseconds waiting for the mdio ctrl to finish read or write.
```

## dts/bindings/pinctrl/sensry,sy1xx-pinctrl.yaml
```yaml
# Copyright (c) 2024 sensry.io
# SPDX-License-Identifier: Apache-2.0

description: Sensry SY1xx PINCTRL

compatible: "sensry,sy1xx-pinctrl"

include: base.yaml

properties:
  reg:
    required: true

child-binding:
  description: Each child node defines the configuration of a particular state.

  include:
    - name: pincfg-node.yaml
      property-allowlist:
        - bias-high-impedance
        - bias-pull-down
        - bias-pull-up
        - input-enable
        - input-schmitt-enable

  properties:
    pinmux:
      required: true
      type: array
      description: |
        Pin mux selection. See the SOC level pinctrl header
        for a defined list of these options.
```

## dts/bindings/spi/sensry,sy1xx-spi.yaml
```yaml
# Copyright (c) 2024 sensry.io
# SPDX-License-Identifier: Apache-2.0

description: Sensry SY1xx SPI

compatible: "sensry,sy1xx-spi"

include: [spi-controller.yaml, pinctrl-device.yaml]

properties:
  reg:
    required: true

  instance:
    type: int
    required: true

  cs-pin:
    type: int
    required: false
    description: SPI controller has 2 dedicated chip select pins that can be controlled
      directly without gpio interaction needed. Set to 0 or 1 to use respective pins. 
      Optionally set -1 in case gpio should be used.

  pinctrl-0:
    required: true
```

## dts/bindings/video/heimann,htpa.yaml
```yaml
# Copyright (c) 2026 sensry.io
# SPDX-License-Identifier: Apache-2.0

description: Heimann HTPA IR camera

compatible: "heimann,htpa"

include: spi-device.yaml
```

## soc/sensry/ganymed/Kconfig.soc
```kconfig
# SPDX-License-Identifier: Apache-2.0
# Copyright (c) 2024 sensry.io

config SOC_SERIES_SY1XX
	bool
	select SOC_FAMILY_GANYMED

config SOC_SERIES
	default "sy1xx" if SOC_SERIES_SY1XX

rsource "*/Kconfig.soc"
```

## soc/sensry/ganymed/sy1xx/Kconfig.soc
```kconfig
# SPDX-License-Identifier: Apache-2.0
# Copyright (c) 2024 sensry.io

config SOC_SY120_GBM
	bool
	select SOC_SERIES_SY1XX

config SOC_SY120_GEN1
	bool
	select SOC_SERIES_SY1XX

config SOC
	default "sy120_gbm" if SOC_SY120_GBM
	default "sy120_gen1" if SOC_SY120_GEN1
```
