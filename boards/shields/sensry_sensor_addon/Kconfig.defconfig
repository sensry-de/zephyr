## drivers/flash/Kconfig.htpa
```kconfig
# Copyright (c) 2026 sensryio
# SPDX-License-Identifier: Apache-2.0

config FLASH_HEIMANN_HTPA
	bool "HTPA family flash driver"
	default y
	depends on DT_HAS_HEIMANN_HTPA_FLASH_ENABLED
	#select FLASH_HAS_DRIVER_ENABLED
	#select FLASH_HAS_PAGE_LAYOUT
	select SPI
	help
	  Calibration flash driver for HTPA family chips.
```

## drivers/ptp_clock/Kconfig.sy1xx
```kconfig
# Copyright (c) 2026 sensry.io
# SPDX-License-Identifier: Apache-2.0

config PTP_CLOCK_SY1XX
	bool "Sensry SY1XX PTP clock driver"
	default y
	depends on DT_HAS_SENSRY_SY1XX_PTP_CLOCK_ENABLED
	select NET_L2_PTP_TIMESTAMPING
	help
	  Enable the Sensry SY1XX PTP clock driver scaffold.

	  The register access functions need to be implemented for the target
	  SY1XX PTP peripheral.
```

## drivers/video/video_hm_htpa/Kconfig
```kconfig
# Copyright (c) 2026 sensry.io
# SPDX-License-Identifier: Apache-2.0

config VIDEO_HEIMANN_HTPA
	bool "Enable Heimann HTPA IR camera"
	depends on DT_HAS_HEIMANN_HTPA_160X120_ENABLED || DT_HAS_HEIMANN_HTPA_120X84_ENABLED
    select SPI
    select SPI_SAM_DMA
    select DMA
    select FLASH
	default y
	help
	  Enable driver for Heimann HTPA IR camera device, based on - Thermopile Infrared Array Sensors,
	  with integrated flash memory that holds temperature calibration and compensation data.

if VIDEO_HEIMANN_HTPA

config VIDEO_HM_HTPA_WORKER_STACK_SIZE
	int "HTPA worker thread stack size"
	default 1024
	help
	  Stack size for the background worker that produces mock frames.

config VIDEO_HM_HTPA_WORKER_PRIORITY
	int "HTPA worker thread priority"
	default 5
	help
	  Priority for the background worker thread.

config VIDEO_HM_HTPA_GRAB_STACK_SIZE
	int "HTPA sensor grab thread stack size"
	default 1024
	help
	  Stack size for the thread that continuously acquires sensor frames.

config VIDEO_HM_HTPA_GRAB_PRIORITY
	int "HTPA sensor grab thread priority"
	default 4
	help
	  Priority for the sensor acquisition thread.

endif # VIDEO_HEIMANN_HTPA
```

## dts/bindings/ptp_clock/sensry,sy1xx-ptp-clock.yaml
```yaml
# Copyright (c) 2026 sensry.io
# SPDX-License-Identifier: Apache-2.0

description: Sensry SY1XX PTP clock

compatible: "sensry,sy1xx-ptp-clock"

include: base.yaml

properties:
  reg:
    required: true
```
