## boards/racyics/fpga_dev_board/fpga_dev_board_edgevision_m4_defconfig
```kconfig
# SPDX-FileCopyrightText: Copyright 2026 sensry.io
# SPDX-License-Identifier: Apache-2.0

CONFIG_XIP=n
```

## boards/racyics/riev_dev_board/board.yml
```yaml
# SPDX-FileCopyrightText: Copyright 2026 sensry.io
# SPDX-License-Identifier: Apache-2.0

board:
  name: riev_dev_board
  full_name: Racyics edgeVision Development Board
  vendor: racyics
  socs:
    - name: edgevision
      variants:
      - name: m85
        cpucluster: m85
      - name: m4
        cpucluster: m4
```

## boards/racyics/riev_dev_board/riev_dev_board_edgevision_m85_defconfig
```kconfig
# SPDX-FileCopyrightText: Copyright 2026 sensry.io
# SPDX-License-Identifier: Apache-2.0

CONFIG_XIP=n

# Enable console
CONFIG_CONSOLE=y
CONFIG_SERIAL=y

# Set UART as device used for both printf & printk 
CONFIG_STDOUT_CONSOLE=y
CONFIG_PRINTK=y
CONFIG_UART_CONSOLE=y

#Enable Power Domain & Runtime Management
CONFIG_POWER_DOMAIN=y
CONFIG_PM_DEVICE=y
CONFIG_PM_DEVICE_RUNTIME=y
CONFIG_PM_DEVICE_POWER_DOMAIN=y
```

## boards/raycics/fpga_dev_board/Kconfig.fpga_dev_board
```kconfig
# SPDX-FileCopyrightText: Copyright 2026 sensry.io
# SPDX-License-Identifier: Apache-2.0

config BOARD_FPGA_DEV_BOARD
	select SOC_EV10_M4 if BOARD_FPGA_DEV_BOARD_EV10_M4
	select SOC_EV10_M85 if BOARD_FPGA_DEV_BOARD_EV10_M85
```

## boards/raycics/fpga_dev_board/board.yml
```yaml
# SPDX-FileCopyrightText: Copyright 2026 sensry.io
# SPDX-License-Identifier: Apache-2.0

board:
  name: fpga_dev_board
  full_name: EdgeVision EV10-FPGA-Board
  vendor: raycics
  socs:
    - name: ev10
      variants:
      - name: m85
        cpucluster: m85
      - name: m4
        cpucluster: m4
```

## drivers/display/Kconfig.racyics_mipi
```kconfig
# Copyright (c) 2026 Racyics GmbH.
# SPDX-License-Identifier: Apache-2.0

config DISPLAY_RACYICS_MIPI
	bool "Racyics MIPI display driver"
	depends on DT_HAS_RACYICS_MIPI_DISPLAY_ENABLED
	depends on MIPI_DSI
	select POWER_DOMAIN
	select PM_DEVICE
	select PM_DEVICE_RUNTIME
	select CACHE_MANAGEMENT if CPU_HAS_DCACHE
	help
	  Enable Racyics MIPI display driver
```

## drivers/display/Kconfig.racyics_qspi
```kconfig
# Copyright (c) 2026 Racyics GmbH.
# SPDX-License-Identifier: Apache-2.0

config DISPLAY_RACYICS_QSPI
    bool "Racyics QSPI display driver"
    depends on DT_HAS_RACYICS_QSPI_DISPLAY_ENABLED
    help
        Enable Racyics QSPI display driver

config DISPLAY_RACYICS_QSPI_BUFFER
    bool "Allocate the display buffer into data_sram1 region"
    depends on DISPLAY_RACYICS_QSPI
    default y
    help
        Allocate the display buffer into data_sram1 region
```

## drivers/i2c/Kconfig.racyics
```kconfig
config I2C_RACYICS_EDGEVISION
	bool "Racyics Edgevision I2C driver"
	default y
	depends on DT_HAS_RACYICS_EDGEVISION_I2C_ENABLED
	help
	  Enable I2C driver for Racyics Edgevision SoC.
```

## drivers/i2s/Kconfig.racyics
```kconfig
config I2S_RACYICS_EDGEVISION
	bool "Racyics Edgevision I2S driver"
	default y
	depends on DT_HAS_RACYICS_EDGEVISION_I2S_ENABLED
	help
	  Enable I2S driver for Racyics Edgevision SoC.
```

## drivers/mipi_dsi/Kconfig.racyics
```kconfig
# Copyright (c) 2026 Racyics GmbH.
# SPDX-License-Identifier: Apache-2.0

config MIPI_DSI_RACYICS
    bool "Racyics MIPI-DSI Host Controler"
    default y
    depends on DT_HAS_RACYICS_MIPI_DSI_ENABLED
    help
        Racyics MIPI DSI controller driver
```

## dts/bindings/display/racyics,mipi.yaml
```yaml
# Copyright (c) 2026 Racyics GmbH.
# SPDX-License-Identifier: Apache-2.0

description: |
  Racyics MIPI DSI display (F&S T070QYH-13CP panel) driven by the EdgeVision display controller
  unit and the DSI2 host.

  The node is a child of the DSI host, the reg property is the DSI virtual channel:

    &mipi_dsi {
            panel: panel@0 {
                    compatible = "racyics,mipi-display";
                    reg = <0>;
                    width = <800>;
                    height = <1280>;
                    data-lanes = <4>;
                    pixel-format = <PANEL_PIXEL_FORMAT_RGB_888>;
                    i2c-bus = <&i2c_controller>;
            };
    };

compatible: "racyics,mipi-display"

include: [display-controller.yaml, lcd-controller.yaml]

on-bus: mipi-dsi

properties:
  reg:
    required: true

  data-lanes:
    type: array
    required: true
    description: |
      Number of DSI data lanes used by the panel. The array holds a single entry.

  i2c-bus:
    type: phandle
    required: true
    description: |
      I2C controller connected to the LED driver which controls the panel reset and backlight.
```

## dts/bindings/display/racyics,qspi.yaml
```yaml
# Copyright (c) 2026 Racyics GmbH.
# SPDX-License-Identifier: Apache-2.0


title: |
  Racyics QSPI display driver

description: | 
  Summary -> TODO

  Here is an example to define a display device:

  \ {
        qspi-display@123456{
          compatible = "racyics,qspi-display";
          reg = <0x123456 0x123456>
          width = <123456>;
          height = <123456>;
          pixel-format = <PANEL_PIXEL_FORMAT_RGB_888>;

          status = "okay";
      };
  };

compatible: "racyics,qspi-display"

include : [display-controller.yaml, lcd-controller.yaml]

properties:
  reg:
    required: true
```

## dts/bindings/i2c/racyics,edgevision-i2c.yaml
```yaml
description: Racyics EdgeVison I2C controller

compatible: "racyics,edgevision-i2c"

include: [i2c-controller.yaml]

properties:
  reg:
    required: true

  interrupts:
    required: true

  sccb-mode:
    type: boolean
    description: |
      Enable SCCB compatibility for camera.
```

## dts/bindings/i2s/racyics,edgevision-i2s.yaml
```yaml
# SPDX-License-Identifier: Apache-2.0

description: Racyics EdgeVision I2S controller

compatible: "racyics,edgevision-i2s"

include: [i2s-controller.yaml]

properties:
  reg:
    required: true

  interrupts:
    required: true

  clocks:
    required: true

  role:
    type: string
    required: true
    enum:
      - "controller"
      - "target"
    description: |
      I2S role. "target" receives bit clock and word select from an external
      controller; "controller" generates them.
```

## dts/bindings/mipi-dsi/racyics,mipi-dsi.yaml
```yaml
# Copyright (c) 2026 Racyics GmbH.
# SPDX-License-Identifier: Apache-2.0

description: Racyics MIPI DSI host

compatible: "racyics,mipi-dsi"

include: [mipi-dsi-host.yaml]
```

## dts/bindings/power-domain/racyics,edgevision-power-domain.yaml
```yaml
# Copyright (c) 2026 Racyics GmbH.
# SPDX-License-Identifier: Apache-2.0

description: Edgevision SoC Power Domain

compatible: "racyics,edgevision-power-domain"
include: power-domain.yaml

properties:
  domain-id:
    type: int
    required: true
    description: Edgevision Power Domain ID
```

## samples/drivers/display/boards/riev_dev_board_edgevision_m85.conf
```kconfig
#
# Copyright (c) 2026 Racyics GmbH.
#
# SPDX-License-Identifier: Apache-2.0
#

CONFIG_I2C=y
CONFIG_MIPI_DSI=y
CONFIG_DISPLAY_RACYICS_MIPI=y
```

## soc/raycics/Kconfig.defconfig
```kconfig
# SPDX-FileCopyrightText: Copyright 2026 sensry.io
# SPDX-License-Identifier: Apache-2.0

if SOC_FAMILY_EDGEVISION

rsource "*/Kconfig.defconfig"

endif # SOC_FAMILY_EDGEVISION
```

## soc/raycics/Kconfig.soc
```kconfig
# SPDX-FileCopyrightText: Copyright 2026 sensry.io
# SPDX-License-Identifier: Apache-2.0

config SOC_FAMILY_EDGEVISION
	bool

config SOC_FAMILY
	default "edgevision" if SOC_FAMILY_EDGEVISION

rsource "*/Kconfig.soc"
```

## soc/raycics/edgevision/Kconfig
```kconfig
# SPDX-FileCopyrightText: Copyright 2026 sensry.io
# SPDX-License-Identifier: Apache-2.0

config SOC_FAMILY_EDGEVISION
	select BUILD_OUTPUT_BIN

if SOC_SERIES_EV1X

rsource "*/Kconfig"

endif # SOC_SERIES_EV1X
```

## soc/raycics/edgevision/Kconfig.defconfig
```kconfig
# SPDX-FileCopyrightText: Copyright 2026 sensry.io
# SPDX-License-Identifier: Apache-2.0

if SOC_SERIES_EV1X

rsource "*/Kconfig.defconfig"

endif
```

## soc/raycics/edgevision/Kconfig.soc
```kconfig
# SPDX-FileCopyrightText: Copyright 2026 sensry.io
# SPDX-License-Identifier: Apache-2.0

rsource "*/Kconfig.soc"
```

## soc/raycics/edgevision/ev1x/Kconfig
```kconfig
# SPDX-FileCopyrightText: Copyright 2026 sensry.io
# SPDX-License-Identifier: Apache-2.0

config SOC_SERIES_EV1X
	select SOC_RESET_HOOK
	select ARM
	# select CPU_HAS_ARM_MPU
	#select CPU_HAS_FPU
	# select CPU_HAS_ARM_SAU
	# select ARMV8_M_DSP
	#select FPU
	# select HAS_SWO
	#select XIP
	#select CPU_CORTEX_M_HAS_DWT
	#select HAS_PM

config SOC_EV10_M4
	select CPU_CORTEX_M4


config SOC_EV10_M85
	select CPU_CORTEX_M85
```

## soc/raycics/edgevision/ev1x/Kconfig.soc
```kconfig
# SPDX-FileCopyrightText: Copyright 2026 sensry.io
# SPDX-License-Identifier: Apache-2.0

config SOC_SERIES_EV1X
	bool
	select SOC_FAMILY_EDGEVISION

config SOC_SERIES
	default "ev1x" if SOC_SERIES_EV1X

config SOC_EV10
	bool
	select SOC_SERIES_EV1X

config SOC_EV10_M4
	bool
	select SOC_EV10
	help
	 Enable the Cortex-M4 core.

config SOC_EV10_M85
	bool
	select SOC_EV10
	help
	 Enable the Cortex-M85 core.

config SOC
	default "ev10" if SOC_EV10
```
